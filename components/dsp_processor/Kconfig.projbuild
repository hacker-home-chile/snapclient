## components/dsp_processor/Kconfig.projbuild
```kconfig
# Config file for ESP32 DSP Processor

menu "ESP32 DSP processor config"
    config USE_DSP_PROCESSOR
        bool "enable signal processing on audio data"
        default false
        help
            enable audio filtering before queueing it to player component

    choice SNAPCLIENT_DSP_FLOW
        prompt "DSP flow"
        default SNAPCLIENT_DSP_FLOW_STEREO
        depends on USE_DSP_PROCESSOR
        help
            Select the DSP flow to use.

        config SNAPCLIENT_DSP_FLOW_STEREO
            bool "Stereo flow"

        config SNAPCLIENT_DSP_FLOW_BASSBOOST
            bool "Bassboost flow"

        config SNAPCLIENT_DSP_FLOW_BIAMP
            bool "Bi-Amp flow"

        config SNAPCLIENT_DSP_FLOW_BASS_TREBLE_EQ
            bool "Bass Treble EQ"
    endchoice

    config USE_BIQUAD_ASM
        bool "Use optimized asm version of Biquad_f32"
        default true
        depends on USE_DSP_PROCESSOR
        help
            Asm version 2 x speed on ESP32 - not working on ESP32-S2

    config SNAPCLIENT_USE_SOFT_VOL
        bool "Use software volume"
        default false
        depends on USE_DSP_PROCESSOR
        help
            Use software volume mixer instead of hardware mixer.

    config SNAPCLIENT_MAX_VOLUME_PERCENT
        int "Maximum volume percent"
        default 80
        range 10 100
        depends on SNAPCLIENT_USE_SOFT_VOL
        help
            Limits the maximum volume to prevent clipping and distortion.
            100 = full scale (no limit), 80 = 80% max (~2dB headroom),
            50 = 50% max (~6dB headroom). Default is 80.

endmenu
```

## main/Kconfig.projbuild
```kconfig
menu "Snapclient Configuration"
    config QEMU_MODE
        bool "QEMU emulation mode"
        default false
        help
            Enable QEMU emulation mode. When enabled, I2S audio output is
            stubbed (data is discarded at real-time rate) and OpenCores
            Ethernet is used instead of WiFi or hardware Ethernet.
            Use this when running the firmware in ESP32 QEMU.

    config SNAPSERVER_USE_MDNS
        bool "Use mDNS"
        default true
        help
            Use mDNS to look for the snapserver to connect to on the local network.

    config SNAPSERVER_HOST
        string "Snapserver host"
        default "192.168.1.158"
        depends on !SNAPSERVER_USE_MDNS
        help
            Host (ip or name) of snapserver to connect to if mDNS is disabled or the mDNS resolution fails.

    config SNAPSERVER_PORT
        int "Snapserver port"
        default 1704
        depends on !SNAPSERVER_USE_MDNS
        help
            Port of the snapserver to connect to.

    config SNAPCLIENT_NAME
        string "snapclient name"
        default "ESP32-Caster"
        help
            Name of the client to register the snapserver.

	menu "HTTP Server Setting"
		config WEB_PORT
			int "User interface HTTP Server Port"
			default 8000
			help
				HTTP server port to use.
	endmenu

	config USE_SAMPLE_INSERTION
        bool "Use sample insertion"
        default true
        help
            There are two syncronization implementations.

            1. APLL tuning (ONLY use with DACs having MCLK input)
            2. sample insertion (duplicates a sample now and then to keep up sync)

            Both approaches have similar performance keeping clients in sync <= 500µs

endmenu
```

## sdkconfig.defaults.pcm5102a
```kconfig
# PCM5102A DAC + plain ESP32 defaults (no PSRAM).
# Layered on top of sdkconfig.defaults via SDKCONFIG_DEFAULTS.
# WiFi credentials are left to menuconfig (idf.py menuconfig in snapclient).

# Device name
CONFIG_SNAPCLIENT_NAME="udp-music-esp32"

# Board / DAC
CONFIG_AUDIO_BOARD_CUSTOM=y
CONFIG_DAC_PCM5102A=y
CONFIG_DAC_I2C_SDA=21
CONFIG_DAC_I2C_SCL=22
CONFIG_DAC_I2C_ADDR=0x20

# I2S pin map (matches the working ~/snapclient/sdkconfig)
CONFIG_MASTER_I2S_MCLK_PIN=0
CONFIG_MASTER_I2S_BCK_PIN=14
CONFIG_MASTER_I2S_LRCK_PIN=13
CONFIG_MASTER_I2S_DATAOUT_PIN=22
CONFIG_PCM5102A_MUTE_PIN=-1
CONFIG_DAC_DMA_AUTO_16BIT_ALIGN=y

# DSP + soft volume
CONFIG_USE_DSP_PROCESSOR=y
CONFIG_SNAPCLIENT_DSP_FLOW_STEREO=y
CONFIG_SNAPCLIENT_USE_SOFT_VOL=y

# UDP audio transport needs a larger lwIP UDP recv mbox.
CONFIG_LWIP_UDP_RECVMBOX_SIZE=32
CONFIG_UDP_RECVMBOX_SIZE=32

# WiFi + snapserver (dev). Override via menuconfig/NVS in production.
CONFIG_WIFI_SSID="hacker-home"
CONFIG_WIFI_PASSWORD="h4ckTh!s"
# WPA2/WPA3 mixed causes the ESP32 to reject many WPA2-only APs. Match the
# reference build at ~/snapclient which happily connects with WPA/WPA2.
CONFIG_WIFI_AUTH_WPA2_WPA3_PSK=n
CONFIG_WIFI_AUTH_WPA_WPA2_PSK=y
# mDNS off → use static server host/port below.
# CONFIG_SNAPSERVER_USE_MDNS is not set
CONFIG_SNAPSERVER_HOST="192.168.0.11"
CONFIG_SNAPSERVER_PORT=1704
# Disable the third-party UDP logger component — it heap-corrupts under load
# on our flow and competes for the lwIP mbox we need for the audio stream.
CONFIG_ESP32_UDP_LOGGER_ENABLED=n

# Temporary: catch heap corruption at the source rather than later in lwIP.
CONFIG_HEAP_POISONING_LIGHT=y
```

## sdkconfig.defaults.qemu
```kconfig
# QEMU-specific sdkconfig overlay
# Usage: idf.py -DSDKCONFIG_DEFAULTS="sdkconfig.defaults;sdkconfig.defaults.qemu" build

# --- QEMU mode flag ---
CONFIG_QEMU_MODE=y

# --- Networking: use OpenCores Ethernet (QEMU built-in) ---
CONFIG_SNAPCLIENT_USE_INTERNAL_ETHERNET=n
CONFIG_SNAPCLIENT_USE_SPI_ETHERNET=n
CONFIG_ETH_USE_OPENETH=y

# --- Disable WiFi (not emulated in QEMU) ---
CONFIG_ESP_WIFI_ENABLED=n

# --- Server connection: direct IP (no mDNS in QEMU) ---
CONFIG_SNAPSERVER_USE_MDNS=n
CONFIG_SNAPSERVER_HOST="10.0.2.2"
CONFIG_SNAPSERVER_PORT=1704

# --- Client identity ---
CONFIG_SNAPCLIENT_NAME="QEMU-Snapclient"

# --- Disable components not available/needed in QEMU ---
CONFIG_ESP_HTTPS_OTA_ALLOW_HTTP=y

# --- Use sample insertion sync (no APLL in QEMU) ---
CONFIG_USE_SAMPLE_INSERTION=y

# --- Partition table: use project's custom table (has storage partition) ---
CONFIG_PARTITION_TABLE_CUSTOM=y
CONFIG_PARTITION_TABLE_CUSTOM_FILENAME="partitions.csv"

# --- Flash: 4MB to match partition table ---
CONFIG_ESPTOOLPY_FLASHSIZE_4MB=y

# --- Reduce build time: disable unused features ---
CONFIG_BT_ENABLED=n
CONFIG_LWIP_IPV6=n

# --- Memory optimizations for QEMU (virtual loopback network) ---
# TCP send buffer: 5840 (4x MSS) instead of default 11680 (8x MSS).
# QEMU's SLiRP has ~0 latency so a large send window is unnecessary.
CONFIG_LWIP_TCP_SND_BUF_DEFAULT=5840
CONFIG_LWIP_TCP_WND_DEFAULT=5840
```
